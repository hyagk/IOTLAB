void setup() {
  // 핀 모드 설정: 핀 13과 핀 4를 출력 모드로 설정
  pinMode(13, OUTPUT);
  pinMode(4, OUTPUT);
  
  // 시리얼 통신 초기화: 9600 보드 속도로 시리얼 통신을 시작합니다.
  Serial.begin(9600);
}

void loop() {
  // 시리얼 버퍼에 데이터가 있는지 확인
  if (Serial.available() > 0) {
    // 시리얼에서 문자 하나를 읽음
    char v = Serial.read();

    // 만약 읽은 문자가 '1'이면, 핀 13을 HIGH로 설정하여 LED를 켭니다.
    if (v == '1') digitalWrite(13, HIGH);

    // 만약 읽은 문자가 '0'이면, 핀 13을 LOW로 설정하여 LED를 끕니다.
    if (v == '0') digitalWrite(13, LOW);

    // 만약 읽은 문자가 '4'이면, 핀 4에 연결된 부저를 사용하여 멜로디를 연주합니다.
    if (v == '4') {
      // 다양한 음계와 지연을 사용하여 멜로디를 연주합니다.
      tone(4, 523, 500); // 라(523 Hz)를 0.5초 동안 연주
      delay(500); // 0.5초 일시 정지

      tone(4, 523, 500); // 라(523 Hz)를 0.5초 동안 연주
      delay(500); // 0.5초 일시 정지

      tone(4, 783, 500); // 솔(783 Hz)를 0.5초 동안 연주
      delay(500); // 0.5초 일시 정지

      tone(4, 783, 500); // 솔(783 Hz)를 0.5초 동안 연주
      delay(500); // 0.5초 일시 정지

      tone(4, 880, 500); // 라#(880 Hz)를 0.5초 동안 연주
      delay(500); // 0.5초 일시 정지

      tone(4, 880, 500); // 라#(880 Hz)를 0.5초 동안 연주
      delay(500); // 0.5초 일시 정지

      tone(4, 783, 500); // 솔(783 Hz)를 0.5초 동안 연주
      delay(500); // 0.5초 일시 정지
    }
  }
}